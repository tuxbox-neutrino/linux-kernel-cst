## arch/arm/mach-apollo/Kconfig
```kconfig
#
# Apollo Machine configuration file
#

if ARCH_APOLLO
menu "Apollo Implementation"

config MACH_APOLLO
	bool

endmenu
endif
```

## arch/arm/mach-kronos/Kconfig
```kconfig
#
# Kronos Machine configuration file
#

if ARCH_KRONOS
menu "Kronos Implementation"

config MACH_KRONOS
	bool

endmenu
endif 
```

## arch/arm/mach-nevis/Kconfig
```kconfig
if ARCH_NEVIS

menu "NXP CX2450X (Nevis) SoC support"
	depends on ARCH_NEVIS

config	MACH_NEVIS
	bool "Nevis IRD board support"
	help
	 Enables NXP CX2450X based IRDs

config  ED_COOLSTREAM_HD1
	depends on MACH_NEVIS
	bool  "CoolStream HD1 IRD"
	default y

config  ARCH_CNXT_EDWARDS
	bool "Conexant Edwards API"
	default y
	help
	 Enables the use of Conexant Edwards API.

config  CNXT_PHYS_OFFSET
	depends on ARCH_CNXT_EDWARDS
	hex "PHYS Offset"
	default 0x0
	help
	 PHYS_OFFSET is the address at which the kernel thinks
	 RAM begins.  If there is an address hole/alias at
	 physical address 0, then PHYS_OFFSET would probably
	 NOT be 0.

config  CNXT_TEXT_OFFSET
	depends on ARCH_CNXT_EDWARDS
	hex "Kernel Text Offset"
	default 0x17048000
	help
	 TEXT_OFFSET tells the kernel where to begin its
	 text section relative to where it thinks the beginning
	 of RAM is.  ie.  The kernel is loaded at
	 TEXT_OFFSET + PHYS_OFFSET.  The kernel requires that
	 this address end in 0xYYYZ8000.  Conexant requires that
	 Z be greater than 0.

config  CNXT_MODULE_START_OFFSET
	depends on ARCH_CNXT_EDWARDS
	hex "Module address space start offset"
	default 0x00FB8000

config  CNXT_MODULE_ADDRESS_SPACE_SIZE
	depends on ARCH_CNXT_EDWARDS
	hex "Module address space size"
	default 0x1000000

config  CNXT_VMALLOC_SIZE
	depends on ARCH_CNXT_EDWARDS
	hex "VMALLOC size"
	default 0x40000000

config  CNXT_DECARM_PHY_ADDRESS
	depends on ARCH_CNXT_EDWARDS
	hex "DECARM Physical Start Address"
	default 0x17800000
	help
	 This is the physical address at which the kernel
	 will reserve memory for use by the DECARM slave CPU.
	 Be sure to avoid any overlapping memory regions with
	 the KAL memory.

config  CNXT_DECARM_CODE_MEM_SIZE
	depends on ARCH_CNXT_EDWARDS
	hex "Conexant DECARM Code Memory Size"
	default 0x00300000
	help
	 This tells the kernel how much memory is being
	 reserved for MALONE. The default is 3MB.

config  CNXT_DECARM_SHARED_MEM_SIZE
	depends on ARCH_CNXT_EDWARDS
	hex "Conexant DECARM Shared Memory Size"
	default 0x00100000
	help
	 This tells the kernel how much memory is being
	 reserved for MALONE shared memory. This memory is
	 is shared between the host CPU and the slave. The
	 default is 1MB.

menu "GPIO MUX defaults"
depends on ARCH_CNXT_EDWARDS
config PLL_CONFIG0_REG_DEFAULT
	hex "PLL CONFIG 0 register"
	default 0xFFFFEFFE

config PLL_ALT_FUNC_REG_DEFAULT
	hex "PLL PIN ALT FUNC register"
	default 0x60000020

config PLL_PRI_GPIO_MUX0_REG_DEFAULT
	hex "PLL PIN GPIO MUX0 REG"
	default 0x0100D000

config PLL_PRI_GPIO_MUX1_REG_DEFAULT
	hex "PLL PIN GPIO MUX1 REG"
	default 0x00000080

config PLL_PRI_GPIO_MUX2_REG_DEFAULT
	hex "PLL PIN GPIO MUX2 REG"
	default 0x00000040

config PLL_PRI_GPIO_MUX3_REG_DEFAULT
	hex "PLL PIN GPIO MUX3 REG"
	default 0xFFBFC380

config PLL_PRI_GPIO_MUX4_REG_DEFAULT
	hex "PLL PIN GPIO MUX4 REG"
	default 0xFFFC0006

config PLL_PRI_GPIO_MUX5_REG_DEFAULT
	hex "PLL PIN GPIO MUX5 REG"
	default 0x0006F209

config PLL_PRI_GPIO_MUX6_REG_DEFAULT
	hex "PLL PIN GPIO MUX6 REG"
	default 0x00000000

config PLL_SEC_GPIO_MUX0_REG_DEFAULT
	hex "PLL SEC PIN MUX0 REG"
	default 0x00000000

config PLL_SEC_GPIO_MUX1_REG_DEFAULT
	hex "PLL SEC PIN MUX1 REG"
	default 0x000030000

config PLL_SEC_GPIO_MUX2_REG_DEFAULT
	hex "PLL SEC PIN MUX2 REG"
	default 0x3F7C0000

config PLL_SEC_GPIO_MUX3_REG_DEFAULT
	hex "PLL SEC PIN MUX3 REG"
	default 0x20000000

config PLL_SEC_GPIO_MUX4_REG_DEFAULT
	hex "PLL SEC PIN MUX4 REG"
	default 0x00000000

config PLL_SEC_GPIO_MUX5_REG_DEFAULT
	hex "PLL SEC PIN MUX5 REG"
	default 0x00000000

config PLL_SEC_GPIO_MUX6_REG_DEFAULT
	hex "PLL SEC PIN MUX6 REG"
	default 0x00000000

endmenu

menu "GPIO options"
	depends on MACH_NEVIS
config	PIO_INIT_ON_BOOT
	bool "Initialize GPIO's on boot"
	default y
	help
	 If enabled, all exisiting GPIO pins will be 
	 initialized to be inputs in the early boot.

config	PIO_EXCL_MASK_PIO_031_000
	depends on PIO_INIT_ON_BOOT
	hex "Exclude mask for PIO  31 to   0"
	default 0x00000000
	help
	 GPIO's marked with 1 here are excluded from
	 the initialization.

config	PIO_EXCL_MASK_PIO_063_032
	depends on PIO_INIT_ON_BOOT
	hex "Exclude mask for PIO  63 to  32"
	default 0x00000000
	help
	 GPIO's marked with 1 here are excluded from
	 the initialization.

config	PIO_EXCL_MASK_PIO_095_064
	depends on PIO_INIT_ON_BOOT
	hex "Exclude mask for PIO  95 to  64"
	default 0x00000000
	help
	 GPIO's marked with 1 here are excluded from
	 the initialization.

config	PIO_EXCL_MASK_PIO_127_096
	depends on PIO_INIT_ON_BOOT
	hex "Exclude mask for PIO 127 to  96"
	default 0x00000000
	help
	 GPIO's marked with 1 here are excluded from
	 the initialization.

config	PIO_EXCL_MASK_PIO_159_128
	depends on PIO_INIT_ON_BOOT
	hex "Exclude mask for PIO 159 to 128"
	default 0x00000000
	help
	 GPIO's marked with 1 here are excluded from
	 the initialization.

config	PIO_EXCL_MASK_PIO_191_160
	depends on PIO_INIT_ON_BOOT
	hex "Exclude mask for PIO 191 to 160"
	default 0x00000000
	help
	 GPIO's marked with 1 here are excluded from
	 the initialization.

config	PIO_EXCL_MASK_PIO_223_192
	depends on PIO_INIT_ON_BOOT
	hex "Exclude mask for PIO 223 to 192"
	default 0x00000000
	help
	 GPIO's marked with 1 here are excluded from
	 the initialization.

endmenu

endmenu

endif
```

## arch/arm/plat-stb/Kconfig
```kconfig
#
# STB Platform configuration file
#

if PLAT_STB

choice
	prompt "Entropic STB SoC Family"

endchoice

config DEBUG_STB_UART
	depends on PLAT_STB
	int
	default "1" if DEBUG_STB_UART1
	default "2" if DEBUG_STB_UART2
	default "3" if DEBUG_STB_UART3

config STB_MEM_RESRV
	depends on PLAT_STB
	bool "Entropic STB Memory pools reservation"
	help
	  Enables the reservation of STB Memory pools.

config STB_SPLASH
	depends on PLAT_STB && STB_MEM_RESRV
	bool "Entropic STB Platform splash screen"
	help
	  Enables splash screen during kernel boot.


endif
```

## drivers/gcs_dmac/Kconfig
```kconfig
menu "GCS DMAC IP_1902 support"

config MTD_NX_NAND_DMAC
  tristate "GCS DMAC IP_1902 support"
	default y if MTD_NX_NAND
  help
    Support for the GCS DMAC IP_1902 block in Apollo

endmenu
```

## drivers/mtd/nand/nx_nand/Kconfig
```kconfig
#NAND driver for STB Platform

menuconfig MTD_NX_NAND
	tristate "NAND Device IP_2070 Support"
	depends on MTD_NAND
	help
	  This enables support for accessing NAND flash
	  devices on TV55X platforms.

if MTD_NX_NAND

choice #ECC options
	prompt "STB SoC ECC options"
	depends on MTD_NX_NAND
	default  MTD_NX_NAND_HWECC

config MTD_NX_NAND_HWECC
	bool "HWECC RS codec support"
	help
	  This is enables the HW ECC provided by IP_2070 controller.
		The controller supports 5 symbols correction per 512 bytes.

config MTD_NX_NAND_SWECC
	bool "SWECC support"
	help
	  This is enables the SW ECC provided by MTD subsytem.
		The controller supports 1 bit correction per 256 bytes.

config MTD_NX_NAND_NONEECC
	bool "ECC support disabled"
	help
	  This is disables the ECC support.

endchoice #ECC options

endif # MTD_NX_NAND

config MTD_NX_NAND_PART_PARSE
  tristate "Partition parser support IP_2070 driver"
  depends on MTD_NX_NAND
  help
    This enables the Flash partition parser functionality
```

## drivers/mtd/sfc/Kconfig
```kconfig
#SFC driver for STB Platforms

menuconfig MTD_NX_SFC
	tristate "SFC Device Support"
	depends on MTD !=n
  select MTD_PARTITIONS
	help
	  This enables support for accessing SFC flash
	  devices on STB platforms.

config MTD_NX_SFC_PREFETCH_EN
	bool "PREFETCH Buffer support"
	depends on MTD_NX_SFC
	help
	  This is enables the prefetch buffer in the SFC controller.
		The controller supports 64 prefetch words.

config MTD_NX_SFC_DMAC_EN
	bool "DMA support"
	depends on MTD_NX_SFC
	help
	  This is enables the A9 to access SFC through the AHB Master Interface.
		 SFC DMA driver is used to xfer the data to/from the SFC apperture in the GCS.

config MTD_NX_SFC_QUAD_MODE
        bool "QUAD Mode support"
	depends on MTD_NX_SFC
        help
          This is enables the Quad Mode in the SFC controller.
```

## drivers/net/cnxt_emac/Kconfig
```kconfig
if ARCH_NEVIS

config CNXT_EMAC
	tristate "CNXT 10/100 EMAC Driver Support"
	depends on NET
	---help---
	This driver support CNXT EMAC Driver.Supports 2 EMAC core(EMAC0/EMAC1).

config CNXT_EMAC0_ENABLE
	bool "Enable EMAC0 interface"
	depends on CNXT_EMAC
	default y
	---help---
	Enables EMAC0 interface in driver.By default this interface is enabled.

config CNXT_EMAC0_2xMODE_ENABLE
	bool "Enable OverClocked MII(2xMode)"
	depends on CNXT_EMAC0_ENABLE
	default 0
	---help---
	Enables EMAC0 interface in 2xMode[OverClocked MII].Resulting in 200Mbps mode.

config EMAC0_MDIO_SUPPORT
	bool "Support MDIO operation in EMAC0"
	depends on CNXT_EMAC0_ENABLE
	default 0
	---help---
	Select 1- MDIO support required, 0- MDIO support not required.

config EMAC0_MDIO_ADDRESS
	hex "EMAC0 MDIO operation address"
	depends on EMAC0_MDIO_SUPPORT
	default 0xFFFFFFFF
	---help---
	Select MDIO address for EMAC0 interface, Default will be 0xFFFFFFFF
	(driver will detect MDIO address).

config CNXT_EMAC1_ENABLE
	bool "Enable EMAC1 interface"
	depends on CNXT_EMAC
	default 0
	---help---
	Enables EMAC1 interface in driver.

config CNXT_EMAC1_2xMODE_ENABLE
	bool "Enable OverClocked MII(2xMode)"
	depends on CNXT_EMAC1_ENABLE
	default 0
	---help---
	Enables EMAC1 interface in 2xMode[OverClocked MII].Resulting in 200Mbps mode.

config EMAC1_MDIO_SUPPORT
	bool "Support MDIO operation in EMAC1"
	depends on CNXT_EMAC1_ENABLE
	default 0
	---help---
	Select 1- MDIO support required, 0- MDIO support not required.

config EMAC1_MDIO_ADDRESS
	hex "EMAC1 MDIO operation address"
	depends on EMAC1_MDIO_SUPPORT
	default 0xFFFFFFFF
	---help---
	Select MDIO address for EMAC1 interface, Default will be 0xFFFFFFFF
	(driver will detect MDIO address).

config MII_GPIO_BANK
	int "MII_GPIO_BANK"
	default 3
	help
	GPIO Bank Number.

config MII_GPIO_BIT
	int "MII_GPIO_BIT"
	default 31
	help
	GPIO bit number.

endif
```

## drivers/staging/rtl8192u/Kconfig
```kconfig
config RTL8192U
	tristate "RealTek RTL8192U Wireless LAN NIC driver"
	depends on WLAN && USB
	depends on m
	select WIRELESS_EXT
	select WEXT_PRIV
	default N
	---help---
```
